/*
       PRU-SHARED-MEM 
*/
/dts-v1/;
/plugin/;
 

/ {
  compatible = "ti,beaglebone", "ti,beaglebone-black";
 
  /* identification */
  part-number = "PRU-SHARED-MEM";
  version = "00A0";
 
  fragment@0{
  target = <&pruss>;
    __overlay__ {
      status = "okay";
    };
  };
};
